## sdkconfig.defaults
```kconfig
# ESP-IDF SDK Configuration Defaults for PulseTracker

# Flash size - 4MB
CONFIG_ESPTOOLPY_FLASHSIZE_4MB=y
CONFIG_ESPTOOLPY_FLASHSIZE="4MB"

# Partition table - use larger single app partition (fits ~3MB app)
CONFIG_PARTITION_TABLE_SINGLE_APP_LARGE=y

# Enable Bluetooth
CONFIG_BT_ENABLED=y

# Use NimBLE (lighter than Bluedroid)
CONFIG_BT_NIMBLE_ENABLED=y
CONFIG_BT_BLUEDROID_ENABLED=n

# NimBLE role config - we are a client (central)
CONFIG_BT_NIMBLE_ROLE_CENTRAL=y
CONFIG_BT_NIMBLE_ROLE_PERIPHERAL=n
CONFIG_BT_NIMBLE_ROLE_BROADCASTER=n
CONFIG_BT_NIMBLE_ROLE_OBSERVER=y

# NimBLE max connections
CONFIG_BT_NIMBLE_MAX_CONNECTIONS=1

# Enable GATT client
CONFIG_BT_NIMBLE_GATT_MAX_PROCS=4

# NimBLE ATT MTU
CONFIG_BT_NIMBLE_ATT_PREFERRED_MTU=256

# WiFi
CONFIG_ESP_WIFI_STATIC_RX_BUFFER_NUM=10
CONFIG_ESP_WIFI_DYNAMIC_RX_BUFFER_NUM=32

# MQTT
CONFIG_MQTT_PROTOCOL_311=y

# FreeRTOS
CONFIG_FREERTOS_HZ=1000

# Log level
CONFIG_LOG_DEFAULT_LEVEL_INFO=y
CONFIG_LOG_DEFAULT_LEVEL=3

# Compiler optimization for size
CONFIG_COMPILER_OPTIMIZATION_SIZE=y
```
